#include <stdio.h>
#include "driver/i2c.h"
#include "ssd1306.h"
#include "esp_log.h"
#include <string.h>

// Basic 5x7 Font (ASCII 32-127)
static const uint8_t font5x7[][5] = {
    {0x00, 0x00, 0x00, 0x00, 0x00}, // space
    {0x00, 0x00, 0x5F, 0x00, 0x00}, // !
    {0x00, 0x07, 0x00, 0x07, 0x00}, // "
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    {0x10, 0x08, 0x08, 0x10, 0x08}, // ~
};

static esp_err_t i2c_master_init(void)
{
    int i2c_master_port = I2C_MASTER_NUM;
    i2c_config_t conf = {
        .mode = I2C_MODE_MASTER,
        .sda_io_num = I2C_MASTER_SDA_IO,
        .sda_pullup_en = GPIO_PULLUP_ENABLE,
        .scl_io_num = I2C_MASTER_SCL_IO,
        .scl_pullup_en = GPIO_PULLUP_ENABLE,
        .master.clk_speed = I2C_MASTER_FREQ_HZ,
    };
    esp_err_t err = i2c_param_config(i2c_master_port, &conf);
    if (err != ESP_OK) return err;
    return i2c_driver_install(i2c_master_port, conf.mode, I2C_MASTER_RX_BUF_DISABLE, I2C_MASTER_TX_BUF_DISABLE, 0);
}

static esp_err_t ssd1306_send_cmd(uint8_t cmd)
{
    uint8_t data_t[2];
    data_t[0] = 0x00; // Co = 0, D/C = 0
    data_t[1] = cmd;
    return i2c_master_write_to_device(I2C_MASTER_NUM, SSD1306_ADDR, data_t, 2, 1000 / portTICK_PERIOD_MS);
}

static esp_err_t ssd1306_send_data(uint8_t *data, uint16_t len)
{
    uint8_t *data_t = malloc(len + 1);
    if (!data_t) return ESP_ERR_NO_MEM;
    
    data_t[0] = 0x40; // Co = 0, D/C = 1
    memcpy(&data_t[1], data, len);
    
    esp_err_t ret = i2c_master_write_to_device(I2C_MASTER_NUM, SSD1306_ADDR, data_t, len + 1, 1000 / portTICK_PERIOD_MS);
    free(data_t);
    return ret;
}

void ssd1306_init(void)
{
    i2c_master_init();
    
    // Initialization Sequence
    ssd1306_send_cmd(0xAE); // Display OFF
    ssd1306_send_cmd(0xD5); // Set Display Clock Divide Ratio
    ssd1306_send_cmd(0x80);
    ssd1306_send_cmd(0xA8); // Set Multiplex Ratio
    ssd1306_send_cmd(0x3F);
    ssd1306_send_cmd(0xD3); // Set Display Offset
    ssd1306_send_cmd(0x00);
    ssd1306_send_cmd(0x40); // Set Start Line
    ssd1306_send_cmd(0x8D); // Charge Pump
    ssd1306_send_cmd(0x14);
    ssd1306_send_cmd(0x20); // Memory Mode
    ssd1306_send_cmd(0x00); // Horizontal Addressing
    ssd1306_send_cmd(0xA1); // Segment Remap
    ssd1306_send_cmd(0xC8); // COM Scan Direction
    ssd1306_send_cmd(0xDA); // Set COM Pins
    ssd1306_send_cmd(0x12);
    ssd1306_send_cmd(0x81); // Set Contrast
    ssd1306_send_cmd(0xCF);
    ssd1306_send_cmd(0xD9); // Set Precharge
    ssd1306_send_cmd(0xF1);
    ssd1306_send_cmd(0xDB); // Set VCOM Detect
    ssd1306_send_cmd(0x40);
    ssd1306_send_cmd(0xA4); // Display All On Resume
    ssd1306_send_cmd(0xA6); // Normal Display
    ssd1306_send_cmd(0xAF); // Display ON
    
    ssd1306_clear_screen();
}

void ssd1306_clear_screen(void)
{
    uint8_t zero[128];
    memset(zero, 0, 128);
    
    for (uint8_t i = 0; i < 8; i++) {
        ssd1306_send_cmd(0xB0 + i);
        ssd1306_send_cmd(0x00);
        ssd1306_send_cmd(0x10);
        ssd1306_send_data(zero, 128);
    }
}

static void ssd1306_put_char(char c) {
    if (c < 32 || c > 126) c = 32; // sanitized
    uint8_t buf[6];
    // Copy font data
    for (int i = 0; i < 5; i++) {
        buf[i] = font5x7[c - 32][i];
    }
    buf[5] = 0x00; // spacing
    ssd1306_send_data(buf, 6);
}

void ssd1306_display_text_x_y(void *arg_text, uint8_t x, uint8_t y)
{
    char *text = (char*)arg_text;
    // Set Page Address
    ssd1306_send_cmd(0xB0 + y);
    // Set Column Address (Lower 4 bits)
    ssd1306_send_cmd(0x00 + (x & 0x0F));
    // Set Column Address (Higher 4 bits)
    ssd1306_send_cmd(0x10 + ((x >> 4) & 0x0F));
    
    while (*text) {
        ssd1306_put_char(*text++);
    }
}

void ssd1306_display_status(float comp_val, float comp_thresh, float turb_val, float turb_thresh, const char* ip, const char* ssid, const char* pwd)
{
    // Line 0: SSID
    // Line 1: PASS
    // Line 2: IP
    // Line 4: Comp Status
    // Line 5: Turb Status
    // Line 6: Thresholds
    
    char buf[32];

    // SSID
    snprintf(buf, sizeof(buf), "SSID:%s", ssid);
    ssd1306_display_text_x_y(buf, 0, 0);

    // PASS
    snprintf(buf, sizeof(buf), "PASS:%s", pwd);
    ssd1306_display_text_x_y(buf, 0, 1);

    // IP
    snprintf(buf, sizeof(buf), "IP:%s", ip);
    ssd1306_display_text_x_y(buf, 0, 2);

    // Compressor
    const char* c_status = (comp_val < comp_thresh) ? "ERR" : "OK ";
    snprintf(buf, sizeof(buf), "C:%.3f %s", comp_val, c_status);
    ssd1306_display_text_x_y(buf, 0, 4);
    
    // Turbine
    const char* t_status = (turb_val < turb_thresh) ? "ERR" : "OK ";
    snprintf(buf, sizeof(buf), "T:%.3f %s", turb_val, t_status);
    ssd1306_display_text_x_y(buf, 0, 5);

    // Thresholds (Info)
    snprintf(buf, sizeof(buf), "Th:%.2f/%.2f", comp_thresh, turb_thresh);
    ssd1306_display_text_x_y(buf, 0, 6);
}
